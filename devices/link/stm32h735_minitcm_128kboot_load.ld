MEMORY
{
	SYSFLASH(RX):		ORIGIN = 0x1ff00000, LENGTH = 128K
	FLASH(RX):			ORIGIN = 0x08000000, LENGTH = 128K

	/* with TCM_AXI_SHARED=2'b00 no ITCM_EXT is usable and we only have the base 64K ITCM */
	ITCM(RWX):			ORIGIN = 0x00000000, LENGTH = 64K

	DTCM(RW):			ORIGIN = 0x20000000, LENGTH = 128K

	/* with TCM_AXI_SHARED=2'b00 AXI SRAM is 320K */
	AXISRAM(RW):		ORIGIN = 0x24000000, LENGTH = 320K

	SRAM1(RW):			ORIGIN = 0x30000000, LENGTH = 16K
	SRAM2(RW):			ORIGIN = 0x30004000, LENGTH = 16K
	/* no SRAM3 */
	SRAM4(RW):			ORIGIN = 0x38000000, LENGTH = 16K
	BACKUPSRAM(RW):		ORIGIN = 0x38800000, LENGTH = 4K

	/* SFRs */
	AHB4(RW):	ORIGIN = 0x58020000, LENGTH = 26K
	APB4(RW): 	ORIGIN = 0x58000000, LENGTH = 27K
	AHB3(RW):	ORIGIN = 0x51000000, LENGTH = 16432K
	APB3(RW):	ORIGIN = 0x50000000, LENGTH = 16K
	AHB2(RW):	ORIGIN = 0x48020000, LENGTH = 18K
	AHB1(RW):	ORIGIN = 0x40020000, LENGTH = 384K
	APB2(RW):	ORIGIN = 0x40010000, LENGTH = 32K
	APB1(RW):	ORIGIN = 0x40000000, LENGTH = 58K
	MCU(RW):	ORIGIN = 0xe0000000, LENGTH = 1024K
	MCU2(RW):	ORIGIN = 0x5c001000, LENGTH = 4K
	SIG(RW):	ORIGIN = 0x1ff00000, LENGTH = 1024K
}

INCLUDE "stm32h735-base.ld"
